## conf/bblayers.conf.sample
```bitbake
# POKY_BBLAYERS_CONF_VERSION is increased each time build/conf/bblayers.conf
# changes incompatibly
POKY_BBLAYERS_CONF_VERSION = "2"

BBPATH = "${TOPDIR}"
BBFILES ?= ""

BBLAYERS ?= " \
  /home/harry/poky-zeus/meta \
  /home/harry/poky-zeus/meta-poky \
  /home/harry/poky-zeus/meta-yocto-bsp \
  /home/harry/poky-zeus/meta-openembedded/meta-oe \
  /home/harry/poky-zeus/meta-openembedded/meta-multimedia \
  /home/harry/poky-zeus/meta-openembedded/meta-networking \
  /home/harry/poky-zeus/meta-openembedded/meta-python \
  /home/harry/poky-zeus/meta-raspberrypi \
  /home/harry/poky-zeus/meta-pipuck \
  "
```

## conf/layer.conf
```bitbake
# We have a conf and classes directory, add to BBPATH
BBPATH .= ":${LAYERDIR}"

# We have recipes-* directories, add to BBFILES
BBFILES += "${LAYERDIR}/recipes-*/*/*.bb \
            ${LAYERDIR}/recipes-*/*/*.bbappend"

BBFILE_COLLECTIONS += "meta-pipuck"
BBFILE_PATTERN_meta-pipuck = "^${LAYERDIR}/"
BBFILE_PRIORITY_meta-pipuck = "6"

LAYERDEPENDS_meta-pipuck = "core"
LAYERSERIES_COMPAT_meta-pipuck = "warrior zeus"
```
